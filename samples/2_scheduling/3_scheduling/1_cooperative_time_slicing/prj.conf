## prj.conf
```kconfig
CONFIG_STDOUT_CONSOLE=y
# enable to use thread names
CONFIG_THREAD_NAME=y
# CONFIG_SCHED_CPU_MASK=y
# CONFIG_DEBUG_THREAD_INFO=y
```

## src/main.c
```c
/* main.c - Hello World demo */

/*
 * Copyright (c) 2012-2014 Wind River Systems, Inc.
 *
 * SPDX-License-Identifier: Apache-2.0
 */

#include <zephyr.h>
#include <sys/printk.h>

/* size of stack area used by each thread */
#define STACKSIZE 1024

/* scheduling priority used by each thread */
#define PRIORITY (-7)

/* delay between greetings (in ms) */
#define SLEEPTIME 500


K_THREAD_STACK_DEFINE(threadA_stack_area, STACKSIZE);
static struct k_thread threadA_data;

K_THREAD_STACK_DEFINE(threadB_stack_area, STACKSIZE);
static struct k_thread threadB_data;

void threadB(void *dummy1, void *dummy2, void *dummy3)
{
	ARG_UNUSED(dummy1);
	ARG_UNUSED(dummy2);
	ARG_UNUSED(dummy3);

	int i = 0;

	printk("thread_b: thread started \n");

	while (i<=3)
	{
		printk("thread_b: thread loop \n");
		k_msleep(SLEEPTIME);

		i += 1;

		if (i==3)
		{	
			k_thread_resume(&threadA_data);
			printk("thread_b: thread_a resumed \n");
			k_thread_suspend(&threadB_data);
			printk("thread_b: returned from suspend \n");
			i = 0;
		}
	}
}

void threadA(void *dummy1, void *dummy2, void *dummy3)
{
	ARG_UNUSED(dummy1);
	ARG_UNUSED(dummy2);
	ARG_UNUSED(dummy3);

	int i = 0;

	printk("thread_a: thread started \n");

	k_thread_suspend(&threadB_data);
	printk("thread_a: thread_b suspended \n");

	while (i<=3)
	{
		printk("thread_a: thread loop \n");
		k_msleep(SLEEPTIME);

		i += 1;

		if (i==3)
		{	
			k_thread_resume(&threadB_data);
			printk("thread_a: thread_b resumed \n");
			k_thread_suspend(&threadA_data);
			printk("thread_a: returned from suspend \n");
			i = 0;
		}
	}
}

void main(void)
{
	k_thread_create(&threadA_data, threadA_stack_area,
			K_THREAD_STACK_SIZEOF(threadA_stack_area),
			threadA, NULL, NULL, NULL,
			PRIORITY, 0, K_FOREVER);
	k_thread_name_set(&threadA_data, "thread_a");


	k_thread_create(&threadB_data, threadB_stack_area,
			K_THREAD_STACK_SIZEOF(threadB_stack_area),
			threadB, NULL, NULL, NULL,
			PRIORITY-1, 0, K_FOREVER);
	k_thread_name_set(&threadB_data, "thread_b");

	k_thread_start(&threadA_data);
	k_thread_start(&threadB_data);
}
```
