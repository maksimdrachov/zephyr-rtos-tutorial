## prj.conf
```kconfig
# General config

# Newlib C library
# Build with newlib library. The newlib library is expected to be
# part of the SDK in this case.
# Newlib is a C standard library implementation intended for use on embedded systems.
CONFIG_NEWLIB_LIBC=y

# Main stack
CONFIG_MAIN_STACK_SIZE=1200

# Networking config
CONFIG_NETWORKING=y
CONFIG_NET_IPV4=y
CONFIG_NET_IPV6=n
CONFIG_NET_TCP=y
CONFIG_NET_SOCKETS=y
CONFIG_NET_SOCKETS_POSIX_NAMES=y

# Network driver config
CONFIG_TEST_RANDOM_GENERATOR=y

# Network address config

# Set network settings for applications
# Allow IP addresses to be set in config file for
# networking client/server sample applications, or
# some link-layer dedicated settings like the channel.
# Beware this is not meant to be used for proper
# provisioning but quick sampling/testing.
CONFIG_NET_CONFIG_SETTINGS=y

# This application wants IPv4 support
# The network application needs IPv4 support to function properly.
# This option makes sure the network application is initialized properly
# in order to use IPv4.
CONFIG_NET_CONFIG_NEED_IPV4=y

# My IPv4 address
CONFIG_NET_CONFIG_MY_IPV4_ADDR="192.168.0.246"

# Peer IPv4 address
# This is only applicable in client side applications that try
# to establish a connection to peer host.
# Use 192.0.2.2 here if uncertain.
# CONFIG_NET_CONFIG_PEER_IPV4_ADDR="192.168.0.239"

CONFIG_NET_ARP=y
```

## src/socket_echo.c
```c
/*
 * Copyright (c) 2017 Linaro Limited
 *
 * SPDX-License-Identifier: Apache-2.0
 */

#include <stdio.h>
#include <stdlib.h>
#include <errno.h>

#ifndef __ZEPHYR__

#include <netinet/in.h>
#include <sys/socket.h>
#include <arpa/inet.h>
#include <unistd.h>

#else

#include <net/socket.h>
#include <kernel.h>
#include <net/ethernet.h>

#endif

#define MY_IPV4_ADDR 1
#define BIND_PORT 4242

void print_ip(unsigned int ip)
{
    unsigned char bytes[4];
    bytes[0] = ip & 0xFF;
    bytes[1] = (ip >> 8) & 0xFF;
    bytes[2] = (ip >> 16) & 0xFF;
    bytes[3] = (ip >> 24) & 0xFF;   
    printf("%d.%d.%d.%d\n", bytes[3], bytes[2], bytes[1], bytes[0]);        
}

void main(void)
{
	int serv;
	struct sockaddr_in bind_addr;
	static int counter;
	int bind_addr_len;
	char my_addr_str[32];

	volatile struct sockaddr_ll dst = { 0 };

	serv = socket(AF_INET, SOCK_STREAM, IPPROTO_TCP);

	if (serv < 0) {
		printf("error: socket: %d\n", errno);
		exit(1);
	}

	bind_addr.sin_family = AF_INET;
	bind_addr.sin_addr.s_addr = htonl(INADDR_ANY);
	bind_addr.sin_port = htons(BIND_PORT);

	if (bind(serv, (struct sockaddr *)&bind_addr, sizeof(bind_addr)) < 0) {
		printf("error: bind: %d\n", errno);
		exit(1);
	}

	if (listen(serv, 5) < 0) {
		printf("error: listen: %d\n", errno);
		exit(1);
	}

	printf("Single-threaded TCP echo server waits for a connection on "
	       "port %d...\n", BIND_PORT);

	bind_addr_len = sizeof(bind_addr);
	if (getsockname(serv, (struct sockaddr *)&bind_addr, &bind_addr_len) < 0)
	{
		printf("error: getsockname");
		exit(1);
	}
	inet_ntop(bind_addr.sin_family, &bind_addr.sin_addr, my_addr_str, sizeof(my_addr_str));
	printf("Local IP address is: %s\n", my_addr_str);
	// printf("Local port is: %d\n", (int) ntohs(bind_addr.sin_port));

	dst.sll_ifindex = net_if_get_by_iface(net_if_get_default());

	while (1) {
		struct sockaddr_in client_addr;
		socklen_t client_addr_len = sizeof(client_addr);
		char addr_str[32];
		int client = accept(serv, (struct sockaddr *)&client_addr,
				    &client_addr_len);

		if (client < 0) {
			printf("error: accept: %d\n", errno);
			continue;
		}

		inet_ntop(client_addr.sin_family, &client_addr.sin_addr,
			  addr_str, sizeof(addr_str));
		printf("Connection #%d from %s\n", counter++, addr_str);

		while (1) {
			char buf[128], *p;
			int len = recv(client, buf, sizeof(buf), 0);
			int out_len;

			if (len <= 0) {
				if (len < 0) {
					printf("error: recv: %d\n", errno);
				}
				break;
			}

			p = buf;
			do {
				out_len = send(client, p, len, 0);
				if (out_len < 0) {
					printf("error: send: %d\n", errno);
					goto error;
				}
				p += out_len;
				len -= out_len;
			} while (len);
		}

error:
		close(client);
		printf("Connection from %s closed\n", addr_str);
	}
}
```
